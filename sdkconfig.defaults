## sdkconfig.defaults
```kconfig
# 心灯 ESP32 专用固件（大报恩寺 / 难陀心灯）
CONFIG_IDF_TARGET="esp32s3"
CONFIG_PARTITION_TABLE_SINGLE_APP_LARGE=y

# 后续启用 Wi-Fi / BLE / MQTT 时使用
CONFIG_BT_ENABLED=y
CONFIG_BT_NIMBLE_ENABLED=y
CONFIG_BT_NIMBLE_ROLE_PERIPHERAL=y
CONFIG_BT_NIMBLE_ROLE_OBSERVER=y
CONFIG_BT_NIMBLE_HOST_TASK_STACK_SIZE=4096
```
